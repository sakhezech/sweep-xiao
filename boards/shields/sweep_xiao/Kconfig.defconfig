## boards/shields/sweep_xiao/Kconfig.defconfig
```kconfig
if SHIELD_SWEEP_XIAO_LEFT

config ZMK_KEYBOARD_NAME
    default "Sweep XIAO"

config ZMK_SPLIT_ROLE_CENTRAL
    default y

endif

if SHIELD_SWEEP_XIAO_LEFT || SHIELD_SWEEP_XIAO_RIGHT

config ZMK_SPLIT
    default y

endif
```

## boards/shields/sweep_xiao/Kconfig.shield
```kconfig
config SHIELD_SWEEP_XIAO_LEFT
    def_bool $(shields_list_contains,sweep_xiao_left)

config SHIELD_SWEEP_XIAO_RIGHT
    def_bool $(shields_list_contains,sweep_xiao_right)
```
